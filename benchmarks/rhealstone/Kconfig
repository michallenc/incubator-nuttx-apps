## benchmarks/rhealstone/Kconfig
```kconfig
#
# For a description of the syntax of this configuration file,
# see the file kconfig-language.txt in the NuttX tools repository.
#

config BENCHMARK_RHEALSTONE
	tristate "Rhealstone benchmarks for NuttX"
	default n
	---help---
		TODO

if BENCHMARK_RHEALSTONE

config BENCHMARK_RHEALSTONE_PRIORITY
	int "Rhealstone benchmark task priority"
	default 100

config BENCHMARK_RHEALSTONE_STACKSIZE
	int "Rhealstone benchmark stack size"
	default DEFAULT_TASK_STACKSIZE

endif
```

## boot/nxboot/Kconfig
```kconfig
#
# For a description of the syntax of this configuration file,
# see the file kconfig-language.txt in the NuttX tools repository.
#

menuconfig BOOT_NXBOOT
	bool "NuttX bootloader"
	default n
	select BCH
	---help---
		Enable support for the minimal NuttX based bootloader.

if BOOT_NXBOOT

config NXBOOT_PRIMARY_SLOT_PATH
	string "Application firmware primary image slot path"
	default "/dev/ota0"
	---help---
		The path to the application firmware image primary slot character
		device driver. The image runs from this location.
		Default: /dev/ota0

config NXBOOT_SECONDARY_SLOT_PATH
	string "Application firmware secondary image slot path"
	default "/dev/ota1"
	---help---
		The path to the application firmware image primary slot character
		device driver. This is either update or recovery slot.
		Default: /dev/ota1

config NXBOOT_TERTIARY_SLOT_PATH
	string "Application firmware tertiary image slot path"
	default "/dev/ota2"
	---help---
		The path to the application firmware image primary slot character
		device driver. This is either update or recovery slot.
		Default: /dev/ota2

config NXBOOT_HEADER_SIZE
	hex "Application firmware image header size"
	default 0x200

config NXBOOT_BOOTLOADER
	bool "Build nxboot bootloader application"
	default n
	select BOARDCTL
	select BOARDCTL_BOOT_IMAGE

if NXBOOT_BOOTLOADER

config NXBOOT_SWRESET_ONLY
	bool "Perform update/revert only on SW reset"
	default n
	select BOARDCTL_RESET_CAUSE
	---help---
		This option ensures the update/revert is performed only for following
		reset causes:
			BOARDIOC_RESETCAUSE_CPU_SOFT: software reset
			BOARDIOC_RESETCAUSE_CPU_RWDT: watchdog error
			BOARDIOC_RESETCAUSE_PIN: reset button

config NXBOOT_PREVENT_DOWNGRADE
	bool "Perform update only for newer version"
	default n

if NXBOOT_PREVENT_DOWNGRADE

config NXBOOT_PREVENT_DOWNGRADE_IGNORE_PRERELEASE
	bool "Ignore prerelease when comparing versions"
	default n

endif # NXBOOT_PREVENT_DOWNGRADE

endif # NXBOOT_BOOTLOADER

endif # BOOT_NXBOOT
```

## examples/adjtime/Kconfig
```kconfig
#
# For a description of the syntax of this configuration file,
# see the file kconfig-language.txt in the NuttX tools repository.
#

config EXAMPLES_ADJTIME
	tristate "Ajdtime fucntion example"
	default n
	---help---
		Enable the Adjtime example

if EXAMPLES_ADJTIME

config EXAMPLES_ADJTIME_PROGNAME
	string "Program name"
	default "adjtime"
	---help---
		This is the name of the program that will be used when the NSH ELF
		program is installed.

config EXAMPLES_ADJTIME_PRIORITY
	int "Adjtime task priority"
	default 100

config EXAMPLES_ADJTIME_STACKSIZE
	int "Adjtime stack size"
	default DEFAULT_TASK_STACKSIZE

endif
```

## examples/cantest/Kconfig
```kconfig
#
# For a description of the syntax of this configuration file,
# see the file kconfig-language.txt in the NuttX tools repository.
#

config EXAMPLES_CANTEST
	tristate "CAN test example"
	default n
	depends on CAN
	---help---
		Enable the CAN packet socket example
```

## examples/lpe/Kconfig
```kconfig
#
# For a description of the syntax of this configuration file,
# see the file kconfig-language.txt in the NuttX tools repository.
#

config EXAMPLES_LPE
	tristate "LPE example"
	default n
	depends on ADC
	---help---
		Enable the LPE example

if EXAMPLES_LPE

config EXAMPLES_ADC_DEVPATH
	string "ADC device path"
	default "/dev/adc0"
	---help---
		The default path to the ADC device. Default: /dev/adc0

config EXAMPLES_FB_DEFAULTFB
	string "Default framebuffer driver"
	default "/dev/fb0"
	---help---
		Default framebuffer drivers.  This selection can be overridden from
		the command line.

config EXAMPLES_LPE_NSAMPLES
	int "Number of Sample Groups"
	default 0
	---help---
		This number of samples is collected and the program terminates.
		Default:  0 (samples are collected indefinitely).

config EXAMPLES_LPE_GROUPSIZE
	int "Number of Samples per Group"
	default 4
	---help---
		The number of samples to read at once. Default: 4

config EXAMPLES_LPE_SWTRIG
	bool "Use software trigger"
	default n
	---help---
		Some ADCs may be configured so there is no automatic or periodic
		conversion of samples.  Rather, the ADC sampling must be trigger by
		software via an ioctl command.  Select this option only if
		applicable for your ADC configuration.  In this case, the test will
		issue the software trigger ioctl before attempting to read from the
		ADC.

config EXAMPLES_LPE_STACKSIZE
	int "lpe stack size"
	default 262144

endif
```
